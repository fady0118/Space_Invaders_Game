// SpaceInvadersGame.c
// Runs on LM4F120/TM4C123
// Fady Abd Elshahid
// This is a starter project for the edX Lab 15 of Embedded Systems Shape The World MOOC
// April 10, 2023

// ******* Required Hardware I/O connections *******************
// Slide pot pin 1 connected to ground
// Slide pot pin 2 connected to PE2/AIN1
// Slide pot pin 3 connected to +3.3V 
// fire button SW1 connected to PE0
// special weapon fire button SW2 connected to PE1
// 8*R resistor DAC bit 0 on PB0 (least significant bit)
// 4*R resistor DAC bit 1 on PB1
// 2*R resistor DAC bit 2 on PB2
// 1*R resistor DAC bit 3 on PB3 (most significant bit)
// LED on PB4
// LED on PB5

// Blue Nokia 5110
// ---------------
// Signal        (Nokia 5110) LaunchPad pin
// Reset         (RST, pin 1) connected to PA7
// SSI0Fss       (CE,  pin 2) connected to PA3
// Data/Command  (DC,  pin 3) connected to PA6
// SSI0Tx        (Din, pin 4) connected to PA5
// SSI0Clk       (Clk, pin 5) connected to PA2
// 3.3V          (Vcc, pin 6) power
// back light    (BL,  pin 7) not connected, consists of 4 white LEDs which draw ~80mA total
// Ground        (Gnd, pin 8) ground

// Red SparkFun Nokia 5110 (LCD-10168)
// -----------------------------------
// Signal        (Nokia 5110) LaunchPad pin
// 3.3V          (VCC, pin 1) power
// Ground        (GND, pin 2) ground
// SSI0Fss       (SCE, pin 3) connected to PA3
// Reset         (RST, pin 4) connected to PA7
// Data/Command  (D/C, pin 5) connected to PA6
// SSI0Tx        (DN,  pin 6) connected to PA5
// SSI0Clk       (SCLK, pin 7) connected to PA2
// back light    (LED, pin 8) not connected, consists of 4 white LEDs which draw ~80mA total

//---------Preprocessor----------
#include <stdio.h>
#include <stdlib.h>
#include <math.h>

#include "ADC.h"
#include "..//tm4c123gh6pm.h"
#include "Nokia5110.h"
#include "TExaS.h"
//-----function_prototype-------
void EnableInterrupts(void);  // Enable interrupts
void Move(void);
void Draw(void);
void Normal_Attack(void);
void Special_Attack(void);
//-----global_variables-------
char String[10]; // null-terminated ASCII string
unsigned long Distance;   // units 0.001 cm
unsigned long ADCdata;    // 12-bit 0 to 4095 sample
unsigned long Flag=0;       // semaphore for enemy movement in the game between systick and main loop
unsigned long TimerCount=0; 
unsigned long FrameCount=0; // enemy movement animation
const unsigned long enemy_width=8;
const unsigned long enemy_height=8;
const unsigned long SpaceShip_width=14;
const unsigned long SpaceShip_height=15;
const unsigned long Laser_width=2;
const unsigned long Laser_height=7;
const unsigned long speed_divider=3; // Enemy moves 1 pixel every 25ms*(speed_divider+1)
unsigned long Attack_Flag=0; 
unsigned long Laser_number=0;
unsigned long Explosion_x;
unsigned long Explosion_y;
unsigned long Explosion_Flag=0;
//--------Initialize SysTick interrupts to trigger at 40Hz--------
void SysTick_Init(unsigned long period){
NVIC_ST_CTRL_R=0;
NVIC_ST_RELOAD_R=period-1; //period=2000,000 for 40hz
NVIC_ST_CURRENT_R=0;
NVIC_SYS_PRI3_R = (NVIC_SYS_PRI3_R&0x00FFFFFF)|0x40000000;    // Priority 2 
NVIC_ST_CTRL_R=0x07;
}
// executes every 25 ms, collects a sample, converts and stores in mailbox
void SysTick_Handler(void){ 
// Flag is a semaphore between SysTick_Handler and handler to call the draw function
Flag=1;		
}

//--------Initialize_PORT_E-----------
// Input: none
// Output: none
//configure PE0(SW1)&PE1(SW2) as interrupt-driven edge-triggered input
void PORTE_Init(void){ volatile unsigned long delay;
	SYSCTL_RCGC2_R|=0x10; 		// enable clock for PORT E 
	delay=SYSCTL_RCGC2_R;
	GPIO_PORTE_DIR_R&=~0x03;				 // configure PE0&PE1 as inputs
	GPIO_PORTE_AFSEL_R&=~0x03;  		 // disable alt funct on PE0&PE1
  GPIO_PORTE_DEN_R |=0x03;  		   // enable digital I/O on PE0&PE1
	GPIO_PORTE_PCTL_R&=~0x000000FF;  // configure PE0&PE1 as GPIO
	GPIO_PORTE_AMSEL_R&=~0x03; 		   // disable analog functionality on PE0&PE1
	GPIO_PORTE_PUR_R|=0x03;    			 // enable weak pull-up on PE0&PE1
	GPIO_PORTE_IS_R&=~0x03;   			 // PE0&PE1 is edge-sensitive
  GPIO_PORTE_IBE_R&=~0x03; 			   // PE0&PE1 is not both edges
  GPIO_PORTE_IEV_R&=~0x03;    		 // PE0&PE1 falling edge event
  GPIO_PORTE_ICR_R=0x03;     			 // clear flag0&1
  GPIO_PORTE_IM_R|=0x03;     		   // arm interrupt on PE0&PE1
  NVIC_PRI1_R = (NVIC_PRI1_R&0xFFFFFF00)|0x0000000A0; // priority 5
  NVIC_EN0_R = 0x00000010;      	 // enable interrupt 4 in NVIC
}

void GPIOPortE_Handler(void){
	if((GPIO_PORTE_RIS_R&0x03)==0x01){//SW1 pushed
			GPIO_PORTE_ICR_R = 0x01;      // acknowledge flag1
			Attack_Flag=1; //semaphore
	}
	if((GPIO_PORTE_RIS_R&0x03)==0x02){//SW2 pushed
			GPIO_PORTE_ICR_R = 0x02;      // acknowledge flag2
			Attack_Flag=2;
	}
}
//-----------------sprite_images--------------------
const unsigned char Enemy1[] ={
 0x42, 0x4D, 0x96, 0x00, 0x00, 0x00, 0x00, 0x00, 0x00, 0x00, 0x76, 0x00, 0x00, 0x00, 0x28, 0x00, 0x00, 0x00, 0x08, 0x00, 0x00, 0x00, 0x08, 0x00, 0x00, 0x00, 0x01, 0x00, 0x04, 0x00, 0x00, 0x00,
 0x00, 0x00, 0x20, 0x00, 0x00, 0x00, 0xC4, 0x0E, 0x00, 0x00, 0xC4, 0x0E, 0x00, 0x00, 0x00, 0x00, 0x00, 0x00, 0x00, 0x00, 0x00, 0x00, 0x00, 0x00, 0x00, 0x00, 0x00, 0x00, 0x80, 0x00, 0x00, 0x80,
 0x00, 0x00, 0x00, 0x80, 0x80, 0x00, 0x80, 0x00, 0x00, 0x00, 0x80, 0x00, 0x80, 0x00, 0x80, 0x80, 0x00, 0x00, 0x80, 0x80, 0x80, 0x00, 0xC0, 0xC0, 0xC0, 0x00, 0x00, 0x00, 0xFF, 0x00, 0x00, 0xFF,
 0x00, 0x00, 0x00, 0xFF, 0xFF, 0x00, 0xFF, 0x00, 0x00, 0x00, 0xFF, 0x00, 0xFF, 0x00, 0xFF, 0xFF, 0x00, 0x00, 0xFF, 0xFF, 0xFF, 0x00, 0xFF, 0x00, 0x00, 0xFF, 0x0F, 0xF0, 0x0F, 0xF0, 0x00, 0xF0,
 0x0F, 0x00, 0xFF, 0xFF, 0xFF, 0xFF, 0xFF, 0x0F, 0xF0, 0xFF, 0xFF, 0xFF, 0xFF, 0xFF, 0x0F, 0xFF, 0xFF, 0xF0, 0x00, 0xFF, 0xFF, 0x00, 0xFF,

};


const unsigned char Enemy2[] ={
 0x42, 0x4D, 0x96, 0x00, 0x00, 0x00, 0x00, 0x00, 0x00, 0x00, 0x76, 0x00, 0x00, 0x00, 0x28, 0x00, 0x00, 0x00, 0x08, 0x00, 0x00, 0x00, 0x08, 0x00, 0x00, 0x00, 0x01, 0x00, 0x04, 0x00, 0x00, 0x00,
 0x00, 0x00, 0x20, 0x00, 0x00, 0x00, 0xC4, 0x0E, 0x00, 0x00, 0xC4, 0x0E, 0x00, 0x00, 0x00, 0x00, 0x00, 0x00, 0x00, 0x00, 0x00, 0x00, 0x00, 0x00, 0x00, 0x00, 0x00, 0x00, 0x80, 0x00, 0x00, 0x80,
 0x00, 0x00, 0x00, 0x80, 0x80, 0x00, 0x80, 0x00, 0x00, 0x00, 0x80, 0x00, 0x80, 0x00, 0x80, 0x80, 0x00, 0x00, 0x80, 0x80, 0x80, 0x00, 0xC0, 0xC0, 0xC0, 0x00, 0x00, 0x00, 0xFF, 0x00, 0x00, 0xFF,
 0x00, 0x00, 0x00, 0xFF, 0xFF, 0x00, 0xFF, 0x00, 0x00, 0x00, 0xFF, 0x00, 0xFF, 0x00, 0xFF, 0xFF, 0x00, 0x00, 0xFF, 0xFF, 0xFF, 0x00, 0x0F, 0x00, 0x00, 0xF0, 0xF0, 0x00, 0x00, 0x0F, 0xFF, 0x0F,
 0xF0, 0xFF, 0x0F, 0xFF, 0xFF, 0xF0, 0xFF, 0x0F, 0xF0, 0xFF, 0xFF, 0xFF, 0xFF, 0xFF, 0x0F, 0xFF, 0xFF, 0xF0, 0x00, 0xFF, 0xFF, 0x00, 0xFF,

};


const unsigned char Laser0[] ={
 0x42, 0x4D, 0xA2, 0x00, 0x00, 0x00, 0x00, 0x00, 0x00, 0x00, 0x76, 0x00, 0x00, 0x00, 0x28, 0x00, 0x00, 0x00, 0x05, 0x00, 0x00, 0x00, 0x0B, 0x00, 0x00, 0x00, 0x01, 0x00, 0x04, 0x00, 0x00, 0x00,
 0x00, 0x00, 0x2C, 0x00, 0x00, 0x00, 0xC4, 0x0E, 0x00, 0x00, 0xC4, 0x0E, 0x00, 0x00, 0x00, 0x00, 0x00, 0x00, 0x00, 0x00, 0x00, 0x00, 0x00, 0x00, 0x00, 0x00, 0x00, 0x00, 0x80, 0x00, 0x00, 0x80,
 0x00, 0x00, 0x00, 0x80, 0x80, 0x00, 0x80, 0x00, 0x00, 0x00, 0x80, 0x00, 0x80, 0x00, 0x80, 0x80, 0x00, 0x00, 0x80, 0x80, 0x80, 0x00, 0xC0, 0xC0, 0xC0, 0x00, 0x00, 0x00, 0xFF, 0x00, 0x00, 0xFF,
 0x00, 0x00, 0x00, 0xFF, 0xFF, 0x00, 0xFF, 0x00, 0x00, 0x00, 0xFF, 0x00, 0xFF, 0x00, 0xFF, 0xFF, 0x00, 0x00, 0xFF, 0xFF, 0xFF, 0x00, 0x00, 0x0F, 0xF0, 0x00, 0x00, 0xFF, 0x00, 0x00, 0x0F, 0xF0,
 0x00, 0x00, 0xFF, 0x00, 0x00, 0x00, 0xFF, 0x70, 0x00, 0x00, 0x0F, 0xF0, 0x00, 0x00, 0x00, 0xFF, 0xF0, 0x00, 0x00, 0x7F, 0xF0, 0x00, 0x00, 0xFF, 0x00, 0x00, 0x0F, 0xF0, 0x00, 0x00, 0xFF, 0x00,
 0x00, 0x00, 0xFF,

};

const unsigned char Laser1[] ={
 0x42, 0x4D, 0x96, 0x00, 0x00, 0x00, 0x00, 0x00, 0x00, 0x00, 0x76, 0x00, 0x00, 0x00, 0x28, 0x00, 0x00, 0x00, 0x04, 0x00, 0x00, 0x00, 0x08, 0x00, 0x00, 0x00, 0x01, 0x00, 0x04, 0x00, 0x00, 0x00,
 0x00, 0x00, 0x20, 0x00, 0x00, 0x00, 0xC4, 0x0E, 0x00, 0x00, 0xC4, 0x0E, 0x00, 0x00, 0x00, 0x00, 0x00, 0x00, 0x00, 0x00, 0x00, 0x00, 0x00, 0x00, 0x00, 0x00, 0x00, 0x00, 0x80, 0x00, 0x00, 0x80,
 0x00, 0x00, 0x00, 0x80, 0x80, 0x00, 0x80, 0x00, 0x00, 0x00, 0x80, 0x00, 0x80, 0x00, 0x80, 0x80, 0x00, 0x00, 0x80, 0x80, 0x80, 0x00, 0xC0, 0xC0, 0xC0, 0x00, 0x00, 0x00, 0xFF, 0x00, 0x00, 0xFF,
 0x00, 0x00, 0x00, 0xFF, 0xFF, 0x00, 0xFF, 0x00, 0x00, 0x00, 0xFF, 0x00, 0xFF, 0x00, 0xFF, 0xFF, 0x00, 0x00, 0xFF, 0xFF, 0xFF, 0x00, 0xFF, 0xFF, 0x00, 0x00, 0x0F, 0xF0, 0x00, 0x00, 0x0F, 0xF0,
 0x00, 0x00, 0x0F, 0xF0, 0x00, 0x00, 0x0F, 0xF0, 0x00, 0x00, 0x0F, 0xF0, 0x00, 0x00, 0x00, 0xF0, 0x00, 0x00, 0x00, 0xF0, 0x00, 0x00, 0xFF,

};

const unsigned char Laser_Normal[] ={
 0x42, 0x4D, 0x92, 0x00, 0x00, 0x00, 0x00, 0x00, 0x00, 0x00, 0x76, 0x00, 0x00, 0x00, 0x28, 0x00, 0x00, 0x00, 0x02, 0x00, 0x00, 0x00, 0x07, 0x00, 0x00, 0x00, 0x01, 0x00, 0x04, 0x00, 0x00, 0x00,
 0x00, 0x00, 0x1C, 0x00, 0x00, 0x00, 0x23, 0x2E, 0x00, 0x00, 0x23, 0x2E, 0x00, 0x00, 0x00, 0x00, 0x00, 0x00, 0x00, 0x00, 0x00, 0x00, 0x00, 0x00, 0x00, 0x00, 0x00, 0x00, 0x80, 0x00, 0x00, 0x80,
 0x00, 0x00, 0x00, 0x80, 0x80, 0x00, 0x80, 0x00, 0x00, 0x00, 0x80, 0x00, 0x80, 0x00, 0x80, 0x80, 0x00, 0x00, 0x80, 0x80, 0x80, 0x00, 0xC0, 0xC0, 0xC0, 0x00, 0x00, 0x00, 0xFF, 0x00, 0x00, 0xFF,
 0x00, 0x00, 0x00, 0xFF, 0xFF, 0x00, 0xFF, 0x00, 0x00, 0x00, 0xFF, 0x00, 0xFF, 0x00, 0xFF, 0xFF, 0x00, 0x00, 0xFF, 0xFF, 0xFF, 0x00, 0xF0, 0x00, 0x00, 0x00, 0x0F, 0x00, 0x00, 0x00, 0xFF, 0x00,
 0x00, 0x00, 0xF0, 0x00, 0x00, 0x00, 0xFF, 0x00, 0x00, 0x00, 0xFF, 0x00, 0x00, 0x00, 0xFF, 0x00, 0x00, 0x00, 0xFF,

};


const unsigned char SpaceShip[] ={
 0x42, 0x4D, 0xEE, 0x00, 0x00, 0x00, 0x00, 0x00, 0x00, 0x00, 0x76, 0x00, 0x00, 0x00, 0x28, 0x00, 0x00, 0x00, 0x0E, 0x00, 0x00, 0x00, 0x0F, 0x00, 0x00, 0x00, 0x01, 0x00, 0x04, 0x00, 0x00, 0x00,
 0x00, 0x00, 0x78, 0x00, 0x00, 0x00, 0xC4, 0x0E, 0x00, 0x00, 0xC4, 0x0E, 0x00, 0x00, 0x00, 0x00, 0x00, 0x00, 0x00, 0x00, 0x00, 0x00, 0x00, 0x00, 0x00, 0x00, 0x00, 0x00, 0x80, 0x00, 0x00, 0x80,
 0x00, 0x00, 0x00, 0x80, 0x80, 0x00, 0x80, 0x00, 0x00, 0x00, 0x80, 0x00, 0x80, 0x00, 0x80, 0x80, 0x00, 0x00, 0x80, 0x80, 0x80, 0x00, 0xC0, 0xC0, 0xC0, 0x00, 0x00, 0x00, 0xFF, 0x00, 0x00, 0xFF,
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 0x00, 0xFF, 0x00, 0x00, 0x00, 0x00, 0x00, 0x00, 0x00, 0x00, 0x00, 0x00, 0x00, 0x00, 0xFF,

};

const unsigned char Explosion_1[] ={
 0x42, 0x4D, 0x96, 0x00, 0x00, 0x00, 0x00, 0x00, 0x00, 0x00, 0x76, 0x00, 0x00, 0x00, 0x28, 0x00, 0x00, 0x00, 0x08, 0x00, 0x00, 0x00, 0x08, 0x00, 0x00, 0x00, 0x01, 0x00, 0x04, 0x00, 0x00, 0x00,
 0x00, 0x00, 0x20, 0x00, 0x00, 0x00, 0xC4, 0x0E, 0x00, 0x00, 0xC4, 0x0E, 0x00, 0x00, 0x00, 0x00, 0x00, 0x00, 0x00, 0x00, 0x00, 0x00, 0x00, 0x00, 0x00, 0x00, 0x00, 0x00, 0x80, 0x00, 0x00, 0x80,
 0x00, 0x00, 0x00, 0x80, 0x80, 0x00, 0x80, 0x00, 0x00, 0x00, 0x80, 0x00, 0x80, 0x00, 0x80, 0x80, 0x00, 0x00, 0x80, 0x80, 0x80, 0x00, 0xC0, 0xC0, 0xC0, 0x00, 0x00, 0x00, 0xFF, 0x00, 0x00, 0xFF,
 0x00, 0x00, 0x00, 0xFF, 0xFF, 0x00, 0xFF, 0x00, 0x00, 0x00, 0xFF, 0x00, 0xFF, 0x00, 0xFF, 0xFF, 0x00, 0x00, 0xFF, 0xFF, 0xFF, 0x00, 0x0F, 0x00, 0x00, 0xF0, 0x00, 0xF0, 0x0F, 0x00, 0xF0, 0x0F,
 0xF0, 0x0F, 0x0F, 0x00, 0x00, 0xF0, 0x0F, 0x00, 0x00, 0xF0, 0xF0, 0x0F, 0xF0, 0x0F, 0x00, 0xF0, 0x0F, 0x00, 0x0F, 0x00, 0x00, 0xF0, 0xFF,

};


const unsigned char image[] ={
 0x42, 0x4D, 0xB6, 0x08, 0x00, 0x00, 0x00, 0x00, 0x00, 0x00, 0x76, 0x00, 0x00, 0x00, 0x28, 0x00, 0x00, 0x00, 0x54, 0x00, 0x00, 0x00, 0x30, 0x00, 0x00, 0x00, 0x01, 0x00, 0x04, 0x00, 0x00, 0x00,
 0x00, 0x00, 0x40, 0x08, 0x00, 0x00, 0xC4, 0x0E, 0x00, 0x00, 0xC4, 0x0E, 0x00, 0x00, 0x00, 0x00, 0x00, 0x00, 0x00, 0x00, 0x00, 0x00, 0x00, 0x00, 0x00, 0x00, 0x00, 0x00, 0x80, 0x00, 0x00, 0x80,
 0x00, 0x00, 0x00, 0x80, 0x80, 0x00, 0x80, 0x00, 0x00, 0x00, 0x80, 0x00, 0x80, 0x00, 0x80, 0x80, 0x00, 0x00, 0x80, 0x80, 0x80, 0x00, 0xC0, 0xC0, 0xC0, 0x00, 0x00, 0x00, 0xFF, 0x00, 0x00, 0xFF,
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 0x00, 0x00, 0x00, 0x00, 0x00, 0x00, 0x00, 0x00, 0x00, 0x00, 0x00, 0x00, 0x00, 0x00, 0x00, 0x00, 0x00, 0x00, 0x00, 0x00, 0x00, 0x00, 0xFF,

};

//-------------Delay_Function----------------
void Delay1ms(unsigned long time){
  unsigned long i;
  while(time > 0){
    i = 5714;  // this number means 1ms
    while(i > 0){
      i = i - 1;
    }
    time = time - 1; // decrements every 1 ms
  }
}

//------------------ Sprites Data Structures ---------------------
struct state{
unsigned long x; // x position
unsigned long y; // y position
const unsigned char *image[2]; //ptr->image
unsigned long life;	//0=dead, 1=alive
};

typedef struct state Stype;
Stype Enemy[5]; // Enemy sprites
Stype player;		// Player sprites
Stype Laser[100];		// Laser sprites

//---------------Enemy_State_Initialization------------
void Enemy_Init(unsigned long random){
	unsigned long spacing=5; //space between enemies 
	for(unsigned long i=0;i<5;i++){
	// The x-position is fed with random value from 0 to 19 which 
	// after adding to the equation make leftmost and righmost pixels on the display
	Enemy[i].x = (i+1)*spacing + i*enemy_width + random; // initial enemy x-positions
	Enemy[i].y=9; // initial enemy y-positions
	// ptr -> images 
	// by using 2 appropriate images and switching between them on every movement, it will give the illusion of motion
	Enemy[i].image[0]=	Enemy1;	
	Enemy[i].image[1]=	Enemy2;	
	Enemy[i].life=1; // enemy life
	}
}
//---------------player_State_Initialization------------
void SpaceShip_Init(void){
	player.x=ADC0_In(); // initail enemy x-positions is the slider position
	player.y=47; // bottom of the screen
	player.image[0]=	SpaceShip;	
	player.life=3;
}
//----------------------Movement------------------------
unsigned long count=1; //related to the movement function
long vertical_array[4]={-1,-1,1,1}; //vertical movement increment array will make zigzag movement 
unsigned long j=0; // vertical_array index
unsigned long x=speed_divider; // for slowing enemy speed
void Move(void){
//---------------player_Move---------------
	// ADC has a precision 12-bits 
	// ADC0_In() ranges between 0 to 4095
	// the player SpaceShip x-position can be from 0 to 84-SpaceShip_width which is 14 (0 to 70)
			// Slider_value - player.x value decides which direction to move the spaceship
			// that will cause the ship to keep moving until it reaches the slider position
				  unsigned long Slider_value;
				  Slider_value=round(((double)ADC0_In()/4095)*(84-SpaceShip_width));  // update player x-position scaled from (0~4095) to (0~70)
					if(Slider_value>player.x){//move right
					player.x+=1; // spaceship speed = 1 px/move
					}
					else if(Slider_value<player.x){// move left
					player.x-=1; 
					}

//---------------Enemy_Move---------------
if(x==speed_divider){
unsigned long i;
	if(count==1){ //move right
				if(Enemy[4].x<84-enemy_width){
					for(i=0;i<5;i++){
						Enemy[i].x+=1; // enemy speed = 1 px/move
						Enemy[i].y+=vertical_array[j];
					}
					j=(j+1)%4; // 0,1,2,3,.....
				}
				else{
					count=(count+1)&0x01; // 1,0,1,0,...
					}
		}

	if(count==0){ // move left
			if(Enemy[0].x>0){
				for(i=0;i<5;i++){
					Enemy[i].x-=1;
					Enemy[i].y+=vertical_array[j];
				}
				j=(j+1)%4;
			}
			else{
					count=(count+1)&0x01; // 1,0,1,0,...
				}
	}
	FrameCount=(FrameCount+1)&0x01; // switches between 2 images on every movement 0,1,0,1,...
}
x=(x+1)%(speed_divider+1); // 0,1,2,3,.....
}

//---------------Enemy&player_Draw------------
void Draw(void){
unsigned long i;
Nokia5110_ClearBuffer(); // clear display
	// draw the enemy
	for(i=0;i<5;i++){
		if(Enemy[i].life>0){
			Nokia5110_PrintBMP(Enemy[i].x, Enemy[i].y, Enemy[i].image[FrameCount], 0);
		}
	}
	// draw the SpaceShip
		if(player.life>0){
			Nokia5110_PrintBMP(player.x, player.y, player.image[0], 0);
		}
		for(unsigned long r=Laser_number;r>1;r--){
	// draw the Laser
		if(Laser[r-1].life==1){ //semaphore
			Nokia5110_PrintBMP(Laser[r-1].x, Laser[r-1].y,Laser[r-1].image[0] , 0);
		}
	}
	//draw the Explosion
		if(Explosion_Flag==1){
		Nokia5110_PrintBMP(Explosion_x, Explosion_y,Explosion_1 , 0);
			Explosion_Flag=0; //Acknowledge
		}
Nokia5110_DisplayBuffer(); //draw buffer

}
//------------------random_number_generator------------------
//Using Source: Numerical Recipes
//constants: a=1664525,c=1013904223,m=2^32
//Inputs: Min value, Max value, Seed value
//Outputs: Returns a random value between Min & Max
unsigned long Randomize(unsigned long MIN,unsigned long MAX,unsigned long x){
	// constants
    unsigned long a=1664525,c=1013904223,m=pow(2,32);
	// Linear congruential generator equation
    x=(a*x+c)%m;
	// scale down to a value between MIN & MAX
    x=round( (((float)x/m)*(MAX-MIN))+MIN );
    return x;
}

//------------Player_Shooting---------------
//SW1-> Normal_Attack which shoots one laser vertically up
//SW2-> Special_Attack which shoots multiple lasers
//The switches are edge-triggered that will set a flag that calls the shooting functions
void Normal_Attack(void){
//first initialize the laser
// The x-position of the laser is the ship midpoint =	player.x + SpaceShip_width/2
	Laser[Laser_number].x = player.x + SpaceShip_width/2-Laser_width/2; // initial laser x-position
	Laser[Laser_number].y=47-SpaceShip_height; // initial laser y-positions
	Laser[Laser_number].image[0]=	Laser_Normal;		// ptr -> images 
	Laser[Laser_number].life=1; // Laser state
}
void Normal_Attack_update(void){
	for(unsigned long r=Laser_number;r>1;r--){
	// Laser tip
		unsigned long Lasertip_x,Lasertip_y;
		Lasertip_x=Laser[r-1].x+Laser_width/2;
		Lasertip_y=Laser[r-1].y-Laser_height;
		// is there a laser
		if(Laser[r-1].life==1){
			//check if laser is out of bounds
			if(Laser[r-1].y==0){
				Laser[r-1].life=0;
			}
			else{
				// check if laser hits enemy
				for(int i=0;i<5;i++){
					if(Enemy[i].life==1 && Lasertip_y>=(Enemy[i].y-enemy_height) && Lasertip_y<=Enemy[i].y  && Lasertip_x>=Enemy[i].x && Lasertip_x<=Enemy[i].x +enemy_width){
						Laser[r-1].life=0;
						Enemy[i].life=0;
						Explosion_x=Enemy[i].x;
						Explosion_y=Enemy[i].y;
						Explosion_Flag=1;
					}
				}

				// update the laser position upwards
				if(Laser[r-1].life==1){
					Laser[r-1].y-=1;
				}
			}
		}
	}
}
void Special_Attack(void){



}
int main(void){ 
	//Initializations
  volatile unsigned long delay;
  TExaS_Init(ADC0_AIN1_PIN_PE2, SSI0_Real_Nokia5110_Scope);  // texas scope
	ADC0_Init();             // initialize ADC0, channel 1, sequencer 3
	Nokia5110_Init();        // initialize Nokia5110 LCD (optional)
	SysTick_Init(2000000);   // initialize SysTick for 40 Hz interrupts
	PORTE_Init();
  EnableInterrupts();      // enable interrupts after initializations
	
// print the game splash screen image
	Nokia5110_PrintBMP(0, 47, image, 0);
	Nokia5110_DisplayBuffer();
// wait 100ms then clear display
	Delay1ms(100);//100 ms delay
	Nokia5110_ClearBuffer();
	Nokia5110_DisplayBuffer();
	//----------Draw_Characters------------
	Enemy_Init(Randomize(0,19,NVIC_ST_CURRENT_R)); //Enemy_State_Initialization seed with current systick value
	SpaceShip_Init(); //player_State_Initialization
	Draw();//draw the characters
  while(1){ 
		// Wait for Flag to be 1 then animate the game
		while(Flag==0){};
		
		Move();
		//Laser Attack
		switch(Attack_Flag){
			case 0x01:
				Normal_Attack();
				Attack_Flag=0;  //acknowledge
				Laser_number++; //Next laser
				break;
			case 0x02:
				Special_Attack();
				Attack_Flag=0; //acknowledge
				break;
			default:
				Attack_Flag=0; //acknowledge
				break;
		}
		Normal_Attack_update();
		Draw();
		
		Flag=0; //Ackowledge systick flag
	}
}